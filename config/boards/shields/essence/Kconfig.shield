## config/boards/shields/essence/Kconfig.shield
```kconfig
# No whitespace after the comma or in your part name!
config SHIELD_ESSENCE_LEFT
    def_bool $(shields_list_contains,essence_left)

# No whitespace after the comma or in your part name!
config SHIELD_ESSENCE_RIGHT
    def_bool $(shields_list_contains,essence_right)

# No whitespace after the comma or in your part name!
config SHIELD_ESSENCE_DONGLE
    def_bool $(shields_list_contains,essence_left_dongle)
```

## config/boards/shields/essence/essence/Kconfig.defconfig
```kconfig
if SHIELD_ESSENCE_LEFT

# Name must be less than 16 characters long!
config ZMK_KEYBOARD_NAME
    default "Essence"

config ZMK_SPLIT_ROLE_CENTRAL
    default y

endif

if SHIELD_ESSENCE_LEFT || SHIELD_ESSENCE_RIGHT

config ZMK_SPLIT
    default y

endif
```
